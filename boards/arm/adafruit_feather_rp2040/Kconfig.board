## boards/arm/adafruit_feather_rp2040/Kconfig.board
```kconfig
# Copyright (c) 2022 Igor Knippenberg
# SPDX-License-Identifier: Apache-2.0

config BOARD_ADAFRUIT_FEATHER_RP2040
	bool "Adafruit Feather RP2040 Board"
	depends on SOC_RP2040
```

## boards/arm/adafruit_feather_rp2040/Kconfig.defconfig
```kconfig
# Copyright (c) 2021 Yonatan Schachter
# SPDX-License-Identifier: Apache-2.0

if BOARD_ADAFRUIT_FEATHER_RP2040

config BOARD
	default "adafruit_feather_rp2040"

config RP2_FLASH_W25Q080
	default y

if I2C

config I2C_DW
	default y

if I2C_DW

config I2C_DW_CLOCK_SPEED
	default 100

endif #I2C_DW

endif #I2C

endif # BOARD_ADAFRUIT_FEATHER_RP2040
```

## drivers/motor/Kconfig
```kconfig
# Motor driver configuration options

# Copyright (c) 2021 arithmetics ITS
# SPDX-License-Identifier: Apache-2.0

menuconfig MOTOR
	bool "Motor Drivers"
	help
	  Enable config options for motor drivers.

if MOTOR

module = MOTOR
module-str = motor
source "subsys/logging/Kconfig.template.log_config"

config MOTOR_INIT_PRIORITY
	int "Motor driver initialization priority"
	default 90
	help
	  System initialization priority for motor drivers.

source "drivers/motor/Kconfig.pca9629a"


endif # MOTOR
```

## drivers/motor/Kconfig.pca9629a
```kconfig
# PCA9629A I2C-bus advanced stepper motor controller configuration options

# Copyright (c) 2021 arithmetics ITS
# SPDX-License-Identifier: Apache-2.0

menuconfig MOTOR_PCA9629A
	bool "PCA9629A Stepper Motor Controllers"
	depends on I2C && NEWLIB_LIBC && NEWLIB_LIBC_FLOAT_PRINTF
	help
	  Enable driver for PCA9629A stepper motor controller.

if MOTOR_PCA9629A

endif # MOTOR_PCA9629A
```

## drivers/sensor/atlas_scientific_oem/Kconfig
```kconfig
# Atlas Scientific OEM Sensor configuration options

# Copyright (c) 2023 Igor Knippenberg <igor.knippenberg@gmail.com>
# SPDX-License-Identifier: Apache-2.0

menuconfig ATLAS_SCIENTIFIC_OEM
	bool "ATLAS_SCIENTIFIC_OEM Capacitance-to-Digital Converter"
	default y
	depends on DT_HAS_ATLAS_OEM_ENABLED
	depends on NEWLIB_LIBC
	select I2C
	help
	  Enable driver for ATLAS_SCIENTIFIC_OEM Capacitance-to-Digital Converter.

if ATLAS_SCIENTIFIC_OEM

choice
	prompt "Trigger mode"
	default ATLAS_SCIENTIFIC_OEM_TRIGGER_NONE
	help
	  Specify the type of triggering used by the driver.

config ATLAS_SCIENTIFIC_OEM_TRIGGER_NONE
	bool "No trigger"

config ATLAS_SCIENTIFIC_OEM_TRIGGER_GLOBAL_THREAD
	bool "Use global thread"
	depends on GPIO
	select ATLAS_SCIENTIFIC_OEM_TRIGGER

config ATLAS_SCIENTIFIC_OEM_TRIGGER_OWN_THREAD
	bool "Use own thread"
	depends on GPIO
	select ATLAS_SCIENTIFIC_OEM_TRIGGER

endchoice

config ATLAS_SCIENTIFIC_OEM_TRIGGER
	bool

config ATLAS_SCIENTIFIC_OEM_THREAD_PRIORITY
	int "Thread priority"
	depends on ATLAS_SCIENTIFIC_OEM_TRIGGER_OWN_THREAD && ATLAS_SCIENTIFIC_OEM_TRIGGER
	default 10
	help
	  Priority of thread used by the driver to handle interrupts.

config ATLAS_SCIENTIFIC_OEM_THREAD_STACK_SIZE
	int "Thread stack size"
	depends on ATLAS_SCIENTIFIC_OEM_TRIGGER_OWN_THREAD && ATLAS_SCIENTIFIC_OEM_TRIGGER
	default 1024
	help
	  Stack size of thread used by the driver to handle interrupts.

endif # ATLAS_SCIENTIFIC_OEM
```

## dts/bindings/motor/nxp,pca9629a.yaml
```yaml
# Copyright (c) 2021 arithmetics ITS
# SPDX-License-Identifier: Apache-2.0

description: PCA9629A I2C-bus advanced stepper motor controller

compatible: "nxp,pca9629a"

include: i2c-device.yaml

properties:
    phase:
      type: string
      required: true
      description: |
        Stepper motor drive format (output waveform)
      enum:
        - "one-phase"
        - "two-phase"
        - "half-step"

    cw-output-state:
      type: string
      required: true
      description: |
        Clockwise output states after the motor stops

        all-off   = Set all outputs low after motor stops
        hold-last = Hold the last output states after motor stops
        all-on    = Set all outputs high after motor stops
      enum:
        - "all-off"
        - "hold-last"
        - "all-on"

    ccw-output-state:
      type: string
      required: true
      description: |
        Counter-clockwise output states after the motor stops

        all-off   = Set all outputs low after motor stops
        hold-last = Hold the last output states after motor stops
        all-on    = Set all outputs high after motor stops
      enum:
        - "all-off"
        - "hold-last"
        - "all-on"
```

## dts/bindings/sensor/atlas,oem.yaml
```yaml
# Copyright (c) 2023 Igor Knippenberg <igor.knippenberg@gmail.com>
# SPDX-License-Identifier: Apache-2.0

description: Atlas Scientific OEM sensor family

compatible: "atlas,oem"

include: [sensor-device.yaml, i2c-device.yaml]

properties:
  int-gpios:
    type: phandle-array
    description: |
      The INT pin defaults to active high when produced by the sensor.
      The property value should ensure the flags properly describe
      the signal that is presented to the driver.

  sensor-type:
    type: string
    required: true
    description: |
      Select the type of Atlas Scientific OEM sensor
    enum:
      - "ph"
      - "orp"
      - "do"
      - "ec"
      - "rtd"
```
